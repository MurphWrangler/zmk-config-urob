/* source keypos definitions */
#include "../zmk-nodefree-config/keypos_def/keypos_36keys.h"
//test
/* map Zen's extra keys */
#define X_LH  &smart_mouse  // thumb row, left
#define X_RH  &kp K_CMENU       // thumb row, right

/* activate bluetooth */
#define CONFIG_WIRELESS 1

/* source the main keymap */
#include "base.keymap"

/* use 5-column layout for Zen */
/ { chosen { zmk,matrix_transform = &five_column_transform; }; };

